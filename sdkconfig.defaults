## sdkconfig.defaults
```kconfig
CONFIG_IDF_TARGET="esp32s3"
CONFIG_PARTITION_TABLE_SINGLE_APP=y
CONFIG_ESP_CONSOLE_UART_DEFAULT=y
CONFIG_ESP_SYSTEM_PANIC_PRINT_REBOOT=y
CONFIG_LOG_DEFAULT_LEVEL_INFO=y
CONFIG_COMPILER_OPTIMIZATION_PERF=y
CONFIG_COMPILER_OPTIMIZATION_ASSERTIONS_DISABLE=y
# CONFIG_SPIRAM is not set
CONFIG_ESPTOOLPY_FLASHFREQ_40M=y
CONFIG_ESP_DEFAULT_CPU_FREQ_MHZ_240=y
CONFIG_ESP_DEFAULT_CPU_FREQ_MHZ=240
CONFIG_I2S_SUPPRESS_DEPRECATE_WARN=y
CONFIG_TUSB_MANUFACTURER="SEWU AUDIO"
CONFIG_TUSB_PRODUCT="SEWU AUDIO"
CONFIG_TUSB_SERIAL_NUM="SEWU-S3"
CONFIG_UAC_SPEAKER_CHANNEL_NUM=2
CONFIG_UAC_MIC_CHANNEL_NUM=0
CONFIG_UAC_SAMPLE_RATE=48000
CONFIG_UAC_TINYUSB_TASK_PRIORITY=8
CONFIG_UAC_TINYUSB_TASK_CORE=0
CONFIG_UAC_SPK_TASK_PRIORITY=8
CONFIG_UAC_SPK_TASK_CORE=0
```
